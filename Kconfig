## Kconfig
```kconfig
choice PROSPECTOR_STATUS_SCREEN_LAYOUT
    prompt "Status screen layout"
    default PROSPECTOR_STATUS_SCREEN_CLASSIC

config PROSPECTOR_STATUS_SCREEN_CLASSIC
    bool "Classic layout"
    help
        Standard Prospector status screen

config PROSPECTOR_STATUS_SCREEN_RADII
    bool "Radii layout"
    help
        Colorful grid layout with rounded widgets

config PROSPECTOR_STATUS_SCREEN_FIELD
    bool "Field layout"
    help
        Minimal layout with flowing typing activity visualization

config PROSPECTOR_STATUS_SCREEN_OPERATOR
    bool "Operator layout"
    help
        Technical and information dense layout

config PROSPECTOR_STATUS_SCREEN_DIAL
    bool "Dial layout"
    help
        Focus-block timer as a 60 minute analogue dial, with layer,
        modifiers, profile and battery as plain text around it. Blocks
        are capped at 60 minutes so the dial never wraps.

endchoice

config PROSPECTOR_ROTATE_DISPLAY_180
    bool "Rotate the display 180 degrees"
    default n

config PROSPECTOR_SHOW_MODIFIERS
    bool "Display modifier key indicators (Cmd, Opt, Ctrl, Shift)"
    default y

config PROSPECTOR_SHOW_INACTIVE_MODIFIERS
    bool "Show inactive modifier indicators (dim when not pressed)"
    default y
    depends on PROSPECTOR_SHOW_MODIFIERS
    help
      When enabled, inactive modifiers are shown with a dim color.
      When disabled, inactive modifiers are hidden completely.
      Only affects classic and field layouts.

config PROSPECTOR_MODIFIER_ORDER
    string "Modifier display order"
    default "GACS"
    depends on PROSPECTOR_SHOW_MODIFIERS
    help
      Order of modifier indicators. Use exactly 4 characters:
      G=GUI/Cmd, A=Alt/Opt, C=Control, S=Shift.
      Each character must appear exactly once.

choice PROSPECTOR_MODIFIER_OS
    prompt "Modifier key style"
    default PROSPECTOR_MODIFIER_OS_MAC
    depends on PROSPECTOR_SHOW_MODIFIERS

config PROSPECTOR_MODIFIER_OS_GENERIC
    bool "Generic (CTRL, ALT, GUI, SHFT)"

config PROSPECTOR_MODIFIER_OS_WINDOWS
    bool "Windows"

config PROSPECTOR_MODIFIER_OS_MAC
    bool "Mac"

endchoice

config PROSPECTOR_USE_AMBIENT_LIGHT_SENSOR
    bool "Use ambient light sensor for auto brightness"
    default y

config PROSPECTOR_FIXED_BRIGHTNESS
    int "Fixed display brightness"
    default 50
    range 1 100
    depends on !PROSPECTOR_USE_AMBIENT_LIGHT_SENSOR

config PROSPECTOR_BRIGHTNESS_STEP
    int "Percent the brightness behaviour steps by"
    default 20
    range 1 50

config PROSPECTOR_LAYER_NAME_UPPERCASE
    bool "Display layer names in uppercase"
    default y
    help
      When enabled, layer names will be converted to uppercase for display.
      Only ASCII is affected; Japanese and other non-Latin names pass through
      unchanged, since they have no case to convert.

config PROSPECTOR_LAYER_FONT_JP
    bool "Japanese glyphs for layer names"
    default n
    help
      Adds a small Japanese subset font as an LVGL fallback behind the layer
      label, so a keymap can set display-name to something like 基本 or 集中.

      Only the characters actually needed are baked in -- currently 18 glyphs
      for roughly 2.3 KB of flash, against about 550 KB for a full CJK face.
      Extend the set by editing SYMBOLS in scripts/gen_jp_font.sh and re-running
      it; see the layer name table in README.md.

      Kanji are also narrower than the Latin they replace: 集中 is 36px where
      "TIMER" is around 65px.
```

## boards/shields/prospector_adapter/src/layouts/dial/Kconfig.defconfig
```kconfig
if PROSPECTOR_STATUS_SCREEN_DIAL

config ZMK_DISPLAY_STATUS_SCREEN_CUSTOM
    select LV_USE_LABEL
    select LV_USE_ARC
    select LV_USE_LINE
    select LV_COLOR_SCREEN_TRANSP

config LV_Z_MEM_POOL_SIZE
    default 20000

endif
```

## dts/bindings/behaviors/zmk,behavior-block-timer.yaml
```yaml
# Copyright (c) 2026 The ZMK Contributors
# SPDX-License-Identifier: MIT

description: |
  Focus-block timer control.

  The single parameter is the block length in minutes. Pressing a binding
  starts (or restarts) a block of that length. A parameter of 0 stops and
  clears the timer.

compatible: "zmk,behavior-block-timer"

include: one_param.yaml
```

## dts/bindings/behaviors/zmk,behavior-prospector-brightness.yaml
```yaml
# Copyright (c) 2026 The ZMK Contributors
# SPDX-License-Identifier: MIT

description: |
  Step the Prospector display backlight.

  The single parameter is BRI_UP or BRI_DOWN from
  dt-bindings/zmk/prospector_brightness.h. Step size is
  CONFIG_PROSPECTOR_BRIGHTNESS_STEP.

compatible: "zmk,behavior-prospector-brightness"

include: one_param.yaml
```

## dts/bindings/zmk,prospector-theme.yaml
```yaml
description: Prospector display theme

compatible: "zmk,prospector-theme"

properties:
  left-panel-bg:
    type: int
    required: false
  mod-panel-bg:
    type: int
    required: false
  battery-panel-bg:
    type: int
    required: false
  arc-bg:
    type: int
    required: false
  arc-indicator:
    type: int
    required: false
  layer-wheel-color:
    type: int
    required: false
  layer-text-color:
    type: int
    required: false
  mod-active-color:
    type: int
    required: false
  mod-inactive-color:
    type: int
    required: false

  # Dial layout. Defaults keep every existing theme node valid without edits —
  # a theme only needs to set what it wants to change.
  dial-wedge:
    type: int
    required: false
    default: 0xf7931b
  dial-face:
    type: int
    required: false
    default: 0x242424
  dial-block:
    type: int
    required: false
    default: 0x3a3a3a
  dial-tick:
    type: int
    required: false
    default: 0x9a9a9a
  dial-hub:
    type: int
    required: false
    default: 0xd8d4cc
  dial-minutes:
    type: int
    required: false
    default: 0x8a8a8a
  dial-profile:
    type: int
    required: false
    default: 0x7b7d93
  dial-battery:
    type: int
    required: false
    default: 0x54806c
  dial-battery-low:
    type: int
    required: false
    default: 0xff3b30
```
